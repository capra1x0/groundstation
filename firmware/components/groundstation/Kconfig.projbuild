## firmware/components/groundstation/Kconfig.projbuild
```kconfig
menu "Groundstation"

config WIFI_SSID
    string "Wi-Fi SSID"
    default ""

config WIFI_PASSWORD
    string "Wi-Fi password"
    default ""

config MQTT_BROKER_URI
    string "MQTT broker URI"
    default "mqtt://192.168.1.10:1883"

endmenu
```
